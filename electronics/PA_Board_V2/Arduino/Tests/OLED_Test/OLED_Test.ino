/**************************************************************************
 This is a test of the 128 * 64 OLED display on the External I2C Bus of thr RADARC Pi Transceiver PA board

 
 **************************************************************************/

#include <Wire.h>
#include <Adafruit_GFX.h>
#include <Adafruit_SSD1306.h>
#include <Temperature_LM75_Derived.h>

#define SCREEN_WIDTH 128 // OLED display width, in pixels
#define SCREEN_HEIGHT 64 // OLED display height, in pixels

#define OLED_RESET     -1 // Reset pin # (or -1 if sharing Arduino reset pin)
#define SCREEN_ADDRESS 0x3C ///< See datasheet for Address; 0x3D for 128x64, 0x3C for 128x32
Adafruit_SSD1306 display(SCREEN_WIDTH, SCREEN_HEIGHT, &Wire1, OLED_RESET);



#define RADARC_LOGO_HEIGHT   44
#define RADARC_LOGO_WIDTH    68

  // 'RADARC68x44', 68x44px
const unsigned char RADARC68x44 [] PROGMEM = {
	0xfc, 0x00, 0x03, 0xff, 0xbf, 0xfc, 0x00, 0x03, 0xf0, 0xfc, 0x00, 0x00, 0x7f, 0x6f, 0xe0, 0x00, 
	0x03, 0xf0, 0xff, 0xff, 0xf8, 0x1f, 0x6f, 0x81, 0xff, 0xff, 0xf0, 0xff, 0xff, 0xff, 0x0f, 0x5f, 
	0x0f, 0xff, 0xff, 0xf0, 0xff, 0xff, 0xff, 0x8f, 0x6f, 0x1f, 0xff, 0xff, 0xf0, 0xff, 0xff, 0xff, 
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	0x00, 0x03, 0xf0, 0xfc, 0x00, 0x03, 0xff, 0xff, 0xfc, 0x00, 0x03, 0xf0
};

Generic_LM75_12Bit temperature(&Wire2);


void setup() {

 
  Serial.begin(9600);

  // SSD1306_SWITCHCAPVCC = generate display voltage from 3.3V internally
  if(!display.begin(SSD1306_SWITCHCAPVCC, SCREEN_ADDRESS)) {
    Serial.println(F("SSD1306 allocation failed"));
    for(;;); // Don't proceed, loop forever
  }

display.clearDisplay();

  display.setTextSize(1); 
  display.setTextColor(SSD1306_WHITE);
  display.setCursor(0, 0);
  display.println("RADARC Pi Transceiver");
  display.setCursor(42, 9);
  display.println("PA Board");
  display.drawBitmap(
    (display.width()  - RADARC_LOGO_WIDTH ) / 2, 19,
    RADARC68x44, RADARC_LOGO_WIDTH, RADARC_LOGO_HEIGHT, 1);    
  display.display();
  delay(4000); // Pause for 4 seconds

}

void loop() {
  bool Transmit_status = false;
  bool Protect_status = false;

// Clear the buffer
  display.clearDisplay();
  display.setTextSize(1); 
  display.setTextColor(SSD1306_WHITE);
  display.setCursor(0, 0);
  display.println("RADARC Pi Transceiver");
  display.setCursor(42, 9);
  display.println("PA Board");
  display.setcursor(0,18)
  display.print("Status: ");
  if(Transmit_status = true) display.println("Transmit");
  elseif(Protect_status = true) display.println("Protect");
  else display.println("Receive");
  display.print("Temp: ");
  display.print(temperature.readTemperatureC(),1);
  display.println(" deg C")
  
  display.display();
  delay(2000);
}

